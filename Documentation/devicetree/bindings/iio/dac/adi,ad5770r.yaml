## Documentation/devicetree/bindings/iio/dac/adi,ad5770r.yaml
```yaml
# SPDX-License-Identifier: (GPL-2.0 OR BSD-2-Clause)
# Copyright 2019 Analog Devices Inc.
%YAML 1.2
---
$id: http://devicetree.org/schemas/bindings/iio/adc/adi,ad5770r.yaml#
$schema: http://devicetree.org/meta-schemas/core.yaml#

title: Analog Devices AD5770R DAC device driver

maintainers:
- Mircea Caprioru <mircea.caprioru@analog.com>

description: |
  Bindings for the Analog Devices AD5770R current DAC device. Datasheet can be
  found here:
    https://www.analog.com/media/en/technical-documentation/data-sheets/AD7124-8.pdf

properties:
  compatible:
    const: adi,ad5770r

  reg:
    description: SPI chip select number for the device
    maxItems: 1

  spi-max-frequency:
    description: |
      Max SPI frequency to use (< 10000000, as per
      Documentation/devicetree/bindings/spi/spi-bus.txt)
    maximum: 10000000

  vref-supply:
    description: Specify the voltage of the external reference used.
    const: vref

  reset-gpios:
    description: |
      GPIO spec for the RESET pin. If specified, it will be
      asserted during driver probe.
    maxItems: 1

required:
  - compatible
  - reg
  - spi-max-frequency

patternProperties:
  "^channel@[0-5]":
    type: object
    description: |
      Represents the external channels which are connected to the DAC.

    properties:
      num:
        description: |
          This represents the channel number
        items:
          minimum: 0
          maximum: 5

      adi,range-microamp:
        description: Output range of the channel.
        items:
          minimum: -60000
          maximum: 100000

    required:
      - num
      - adi,range-microamp

example:
  - |
    ad5770r@0 {
    	compatible = "ad5770r";
    	reg = <0>;
        spi-max-frequency = <1000000>;
    	vref-supply = <&vref>;

    	reset-gpios = <&gpio 22 0>;

    	channel@0 {
    		num = <0>;
    		adi,range-microamp = <0 300000>;
    	};

    	channel@1 {
    		num = <1>;
    		adi,range-microamp = <0 140000>;
    	};

    	channel@2 {
    		num = <2>;
    		adi,range-microamp = <0 55000>;
    	};

    	channel@3 {
    		num = <3>;
    		adi,range-microamp = <0 45000>;
    	};

    	channel@4 {
    		num = <4>;
    		adi,range-microamp = <0 45000>;
    	};

    	channel@5 {
    		num = <5>;
    		adi,range-microamp = <0 45000>;
    	};
   };
```
